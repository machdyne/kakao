## buildroot/Config.in
```kconfig
source "$BR2_EXTERNAL_LITEX_VEXRISCV_PATH/package/dhrystone-opt/Config.in"

config BR2_PACKAGE_VEXRISCV_AES
	bool "VexRiscv AES custom instruction"
	help
	  Enable VexRiscv AES custom instruction usage in openssl and dropbear

source "$BR2_EXTERNAL_LITEX_VEXRISCV_PATH/package/tinyscheme/Config.in"
source "$BR2_EXTERNAL_LITEX_VEXRISCV_PATH/package/tcc/Config.in"
source "$BR2_EXTERNAL_LITEX_VEXRISCV_PATH/package/tlinks/Config.in"
source "$BR2_EXTERNAL_LITEX_VEXRISCV_PATH/package/netkit-telnet/Config.in"
source "$BR2_EXTERNAL_LITEX_VEXRISCV_PATH/package/zssh/Config.in"
source "$BR2_EXTERNAL_LITEX_VEXRISCV_PATH/package/llamac/Config.in"
source "$BR2_EXTERNAL_LITEX_VEXRISCV_PATH/package/nanox/Config.in"
source "$BR2_EXTERNAL_LITEX_VEXRISCV_PATH/package/jp2a/Config.in"
source "$BR2_EXTERNAL_LITEX_VEXRISCV_PATH/package/xfer/Config.in"
```

## buildroot/configs/kakao_defconfig
```kconfig
# Target options
BR2_riscv=y
BR2_RISCV_32=y

# Instruction Set Extensions
BR2_riscv_custom=y
BR2_RISCV_ISA_CUSTOM_RVM=y
BR2_RISCV_ISA_CUSTOM_RVA=y
BR2_RISCV_ISA_CUSTOM_RVC=n
#BR2_RISCV_ISA_CUSTOM_RVF=y  # Uncomment to enable FPU
#BR2_RISCV_ISA_CUSTOM_RVD=y  # Uncomment to enable FPU
BR2_RISCV_ISA_RVM=y
BR2_RISCV_ISA_RVA=y
BR2_RISCV_ISA_RVC=n
#BR2_RISCV_ISA_RVF=y  # Uncomment to enable FPU
#BR2_RISCV_ISA_RVD=y  # Uncomment to enable FPU
BR2_RISCV_ABI_ILP32=y

# Patches
BR2_GLOBAL_PATCH_DIR="$(BR2_EXTERNAL_LITEX_VEXRISCV_PATH)/patches"

# GCC
BR2_GCC_VERSION_11_X=y
#BR2_GCC_VERSION_14_X=y

# System
BR2_TARGET_GENERIC_GETTY=y
BR2_TARGET_GENERIC_GETTY_PORT="console"

# Filesystem
BR2_TARGET_ROOTFS_CPIO=y
BR2_TARGET_ROOTFS_CPIO_GZIP=y

# Kernel (litex-rebase branch)
BR2_LINUX_KERNEL=y
BR2_LINUX_KERNEL_CUSTOM_GIT=y
BR2_LINUX_KERNEL_CUSTOM_REPO_URL="https://github.com/Dolu1990/litex-linux.git"
BR2_LINUX_KERNEL_CUSTOM_REPO_VERSION="ae80e67c6b48bbedcd13db753237a25b3dec8301"
BR2_LINUX_KERNEL_USE_CUSTOM_CONFIG=y
BR2_LINUX_KERNEL_CUSTOM_CONFIG_FILE="$(BR2_EXTERNAL_LITEX_VEXRISCV_PATH)/board/litex_vexriscv_usbhost/linux.config"
BR2_LINUX_KERNEL_IMAGE=y

# Rootfs customisation
BR2_ROOTFS_OVERLAY="$(BR2_EXTERNAL_LITEX_VEXRISCV_PATH)/rootfs_overlay"
BR2_GLOBAL_PATCH_DIR="$(BR2_EXTERNAL_LITEX_VEXRISCV_PATH)/patches"

#BR2_PACKAGE_HOST_LINUX_HEADERS_CUSTOM_6_1=y
#BR2_PACKAGE_HOST_LINUX_HEADERS_CUSTOM_5_18=y

# Extra packages
#BR2_PACKAGE_DHRYSTONE_OPT=y
#BR2_PACKAGE_MICROPYTHON=y
#BR2_PACKAGE_SPIDEV_TEST=y
#BR2_PACKAGE_MTD=y
#BR2_PACKAGE_MTD_JFFS_UTILS=y

# Crypto
#BR2_PACKAGE_LIBATOMIC_OPS_ARCH_SUPPORTS=y
#BR2_PACKAGE_LIBATOMIC_OPS=y
#BR2_PACKAGE_OPENSSL=y
#BR2_PACKAGE_LIBRESSL=y
#BR2_PACKAGE_LIBRESSL_BIN=y
#BR2_PACKAGE_HAVEGED=y
#BR2_PACKAGE_VEXRISCV_AES=y # Uncomment to enable hardware AES

BR2_PACKAGE_BUSYBOX_CONFIG_FRAGMENT_FILES="$(BR2_EXTERNAL_LITEX_VEXRISCV_PATH)/configs/busybox.config"

# Kakao
BR2_TOOLCHAIN_BUILDROOT_CXX=y
BR2_PACKAGE_NCURSES=y
BR2_PACKAGE_NANO=y
BR2_PACKAGE_NANO_TINY=y
BR2_PACKAGE_LIBFFI=n
BR2_PACKAGE_MICROPYTHON=n
BR2_PACKAGE_TINYSCHEME=y
BR2_PACKAGE_TCC=y
BR2_PACKAGE_GLIBC_UTILS=n
BR2_PACKAGE_TLINKS=y
BR2_PACKAGE_NETKIT_TELNET=y
BR2_PACKAGE_NETKIT_TELNET_REMOVE_LIBSTDCPP=y
BR2_PACKAGE_ZSSH=y
BR2_PACKAGE_LRZSZ=y
BR2_PACKAGE_FBV=y
BR2_PACKAGE_FBV_PNG=y
BR2_PACKAGE_FBV_JPEG=y
BR2_PACKAGE_FBV_GIF=y
BR2_PACKAGE_SCREEN=y
BR2_PACKAGE_PICOCOM=n
BR2_PACKAGE_MINICOM=n
BR2_PACKAGE_DROPBEAR=y
BR2_PACKAGE_DROPBEAR_CLIENT=y
BR2_PACKAGE_DROPBEAR_SMALL=y
```

## buildroot/configs/kakao_qemu_defconfig
```kconfig
# Target options
BR2_riscv=y
BR2_RISCV_32=y

# Patches
BR2_GLOBAL_PATCH_DIR="$(BR2_EXTERNAL_LITEX_VEXRISCV_PATH)/patches"

# GCC
#BR2_GCC_VERSION_11_X=y
#BR2_GCC_VERSION_14_X=y

# System
BR2_TARGET_GENERIC_GETTY=y
#BR2_TARGET_GENERIC_GETTY_PORT="console"

# Filesystem
BR2_TARGET_ROOTFS_EXT2=y
BR2_TARGET_ROOTFS_CPIO=y
BR2_TARGET_ROOTFS_CPIO_GZIP=y

# Image
BR2_ROOTFS_POST_IMAGE_SCRIPT="board/qemu/post-image.sh"
BR2_ROOTFS_POST_SCRIPT_ARGS="$(BR2_DEFCONFIG)"

# Linux headers same as kernel
BR2_PACKAGE_HOST_LINUX_HEADERS_CUSTOM_6_6=y

# Kernel
BR2_LINUX_KERNEL=y
BR2_LINUX_KERNEL_CUSTOM_VERSION=y
BR2_LINUX_KERNEL_CUSTOM_VERSION_VALUE="6.6.18"
BR2_LINUX_KERNEL_DEFCONFIG="rv32"
BR2_LINUX_KERNEL_IMAGE=y

# Bootloader
BR2_TARGET_OPENSBI=y
BR2_TARGET_OPENSBI_CUSTOM_VERSION=y
BR2_TARGET_OPENSBI_CUSTOM_VERSION_VALUE="1.2"
BR2_TARGET_OPENSBI_PLAT="generic"

# Rootfs customisation
BR2_ROOTFS_OVERLAY="$(BR2_EXTERNAL_LITEX_VEXRISCV_PATH)/rootfs_overlay"
BR2_GLOBAL_PATCH_DIR="$(BR2_EXTERNAL_LITEX_VEXRISCV_PATH)/patches"

#BR2_PACKAGE_HOST_LINUX_HEADERS_CUSTOM_6_1=y
#BR2_PACKAGE_HOST_LINUX_HEADERS_CUSTOM_5_18=y

# Extra packages
#BR2_PACKAGE_DHRYSTONE_OPT=y
#BR2_PACKAGE_MICROPYTHON=y
#BR2_PACKAGE_SPIDEV_TEST=y
#BR2_PACKAGE_MTD=y
#BR2_PACKAGE_MTD_JFFS_UTILS=y

# Crypto
#BR2_PACKAGE_LIBATOMIC_OPS_ARCH_SUPPORTS=y
#BR2_PACKAGE_LIBATOMIC_OPS=y
#BR2_PACKAGE_OPENSSL=y
#BR2_PACKAGE_LIBRESSL=y
#BR2_PACKAGE_LIBRESSL_BIN=y
#BR2_PACKAGE_HAVEGED=y
#BR2_PACKAGE_VEXRISCV_AES=y # Uncomment to enable hardware AES

BR2_PACKAGE_BUSYBOX_CONFIG_FRAGMENT_FILES="$(BR2_EXTERNAL_LITEX_VEXRISCV_PATH)/configs/busybox.config"

# Kakao
BR2_TOOLCHAIN_BUILDROOT_CXX=y
BR2_PACKAGE_NCURSES=y
BR2_PACKAGE_NANO=y
BR2_PACKAGE_NANO_TINY=y
BR2_PACKAGE_LIBFFI=n
BR2_PACKAGE_MICROPYTHON=y
BR2_PACKAGE_TINYSCHEME=y
BR2_PACKAGE_TCC=y
BR2_PACKAGE_GLIBC_UTILS=n
BR2_PACKAGE_TLINKS=y
BR2_PACKAGE_NETKIT_TELNET=y
BR2_PACKAGE_NETKIT_TELNET_REMOVE_LIBSTDCPP=y
BR2_PACKAGE_ZSSH=y
BR2_PACKAGE_LRZSZ=y
BR2_PACKAGE_FBV=y
BR2_PACKAGE_FBV_PNG=y
BR2_PACKAGE_FBV_JPEG=y
BR2_PACKAGE_FBV_GIF=y
BR2_PACKAGE_SCREEN=y
BR2_PACKAGE_PICOCOM=n
BR2_PACKAGE_MINICOM=n
BR2_PACKAGE_DROPBEAR=y
BR2_PACKAGE_DROPBEAR_CLIENT=y
BR2_PACKAGE_DROPBEAR_SMALL=y
```

## buildroot/configs/kakao_sdroot_defconfig
```kconfig
# Target options
BR2_riscv=y
BR2_RISCV_32=y

# Instruction Set Extensions
BR2_riscv_custom=y
BR2_RISCV_ISA_CUSTOM_RVM=y
BR2_RISCV_ISA_CUSTOM_RVA=y
BR2_RISCV_ISA_CUSTOM_RVC=n
#BR2_RISCV_ISA_CUSTOM_RVF=y  # Uncomment to enable FPU
#BR2_RISCV_ISA_CUSTOM_RVD=y  # Uncomment to enable FPU
BR2_RISCV_ISA_RVM=y
BR2_RISCV_ISA_RVA=y
BR2_RISCV_ISA_RVC=n
#BR2_RISCV_ISA_RVF=y  # Uncomment to enable FPU
#BR2_RISCV_ISA_RVD=y  # Uncomment to enable FPU
BR2_RISCV_ABI_ILP32=y

# Patches
BR2_GLOBAL_PATCH_DIR="$(BR2_EXTERNAL_LITEX_VEXRISCV_PATH)/patches"

# GCC
BR2_GCC_VERSION_12_X=y
#BR2_GCC_VERSION_11_X=y

# System
BR2_TARGET_GENERIC_GETTY=y
BR2_TARGET_GENERIC_GETTY_PORT="console"
BR2_TARGET_TZ_INFO=y

# Filesystem
BR2_TARGET_ROOTFS_CPIO=y

# Kernel (litex-rebase branch)
BR2_LINUX_KERNEL=y
BR2_LINUX_KERNEL_CUSTOM_GIT=y
BR2_LINUX_KERNEL_CUSTOM_REPO_URL="https://github.com/machdyne/litex-linux.git"
BR2_LINUX_KERNEL_CUSTOM_REPO_VERSION="litex-monochrome"
BR2_LINUX_KERNEL_USE_CUSTOM_CONFIG=y
BR2_LINUX_KERNEL_CUSTOM_CONFIG_FILE="$(BR2_EXTERNAL_LITEX_VEXRISCV_PATH)/board/litex_vexriscv_usbhost/linux.config"
BR2_LINUX_KERNEL_IMAGE=y

# Rootfs customisation
BR2_ROOTFS_OVERLAY="$(BR2_EXTERNAL_LITEX_VEXRISCV_PATH)/rootfs_overlay"
BR2_GLOBAL_PATCH_DIR="$(BR2_EXTERNAL_LITEX_VEXRISCV_PATH)/patches"

BR2_PACKAGE_HOST_LINUX_HEADERS_CUSTOM_6_1=y

# Extra packages
#BR2_PACKAGE_DHRYSTONE_OPT=y
#BR2_PACKAGE_MICROPYTHON=y
#BR2_PACKAGE_SPIDEV_TEST=y
#BR2_PACKAGE_MTD=y
#BR2_PACKAGE_MTD_JFFS_UTILS=y

# Crypto
#BR2_PACKAGE_LIBATOMIC_OPS_ARCH_SUPPORTS=y
#BR2_PACKAGE_LIBATOMIC_OPS=y
#BR2_PACKAGE_OPENSSL=y
#BR2_PACKAGE_LIBRESSL=y
#BR2_PACKAGE_LIBRESSL_BIN=y
#BR2_PACKAGE_HAVEGED=y
#BR2_PACKAGE_VEXRISCV_AES=y # Uncomment to enable hardware AES

BR2_PACKAGE_BUSYBOX_CONFIG_FRAGMENT_FILES="$(BR2_EXTERNAL_LITEX_VEXRISCV_PATH)/configs/busybox.config"

# Kakao basics
BR2_TARGET_GENERIC_HOSTNAME=kakao
BR2_TOOLCHAIN_BUILDROOT_CXX=y
BR2_PACKAGE_NCURSES=y
BR2_PACKAGE_NANO=y
BR2_PACKAGE_LIBFFI=y
BR2_PACKAGE_TCC=y
BR2_PACKAGE_MICROPYTHON=y
BR2_PACKAGE_TINYSCHEME=y
BR2_PACKAGE_LINKS=y
BR2_PACKAGE_NETKIT_TELNET=y
BR2_PACKAGE_ZSSH=y
BR2_PACKAGE_LRZSZ=y
BR2_PACKAGE_FBV=y
BR2_PACKAGE_FBV_PNG=y
BR2_PACKAGE_FBV_JPEG=y
#BR2_PACKAGE_FBV_GIF=y
BR2_PACKAGE_MUPDF=y
BR2_PACKAGE_IMAGEMAGICK=y
BR2_PACKAGE_SCREEN=y
BR2_PACKAGE_PICOCOM=y
BR2_PACKAGE_DROPBEAR=y
BR2_PACKAGE_DROPBEAR_CLIENT=y
BR2_PACKAGE_DROPBEAR_SMALL=y

# Extras for sdroot
BR2_PACKAGE_BUSYBOX_SHOW_OTHERS=y
BR2_PACKAGE_BASH=y
BR2_PACKAGE_GPM=y
BR2_PACKAGE_LESS=y
BR2_PACKAGE_MG=y
BR2_PACKAGE_NANOX=y
BR2_PACKAGE_NCURSES_WCHAR=y
BR2_PACKAGE_MINICOM=y
BR2_PACKAGE_MC=y
BR2_PACKAGE_BINUTILS=y
BR2_PACKAGE_MAKE=y
BR2_PACKAGE_E2FSPROGS=y
BR2_PACKAGE_DOSFSTOOLS=y
BR2_PACKAGE_NTP=y
BR2_PACKAGE_WGET=y
BR2_PACKAGE_LYNX=y
BR2_PACKAGE_LLAMAC=y
BR2_PACKAGE_GNUPG=y

# Programming / math
BR2_PACKAGE_BC=y
BR2_PACKAGE_PYTHON3=y
BR2_PACKAGE_LUA=y

# Games
BR2_PACKAGE_ASCII_INVADERS=y

# Audio
BR2_PACKAGE_ALSA_LIB=y
BR2_PACKAGE_ALSA_UTILS=y
BR2_PACKAGE_PORTAUDIO=y
BR2_PACKAGE_PORTAUDIO_ALSA=y
BR2_PACKAGE_SOX=y
BR2_PACKAGE_ESPEAK=y
BR2_PACKAGE_ESPEAK_AUDIO_BACKEND_ALSA=y

# Networking
BR2_PACKAGE_IPTABLES=y
BR2_PACKAGE_DNSMASQ=y
BR2_PACKAGE_TRACEROUTE=y

# Misc
BR2_PACKAGE_FBTERM=y
BR2_PACKAGE_FB_TEST_APP=y

# Filesystems
BR2_PACKAGE_F2FS_TOOLS=y

# FPGA tools
BR2_PACKAGE_OPENFPGALOADER=y
```

## buildroot/configs/kakao_sup_defconfig
```kconfig
# Target options
BR2_riscv=y
BR2_RISCV_32=y

# Instruction Set Extensions
BR2_riscv_custom=y
BR2_RISCV_ISA_CUSTOM_RVM=y
BR2_RISCV_ISA_CUSTOM_RVA=y
BR2_RISCV_ISA_CUSTOM_RVC=n
#BR2_RISCV_ISA_CUSTOM_RVF=y  # Uncomment to enable FPU
#BR2_RISCV_ISA_CUSTOM_RVD=y  # Uncomment to enable FPU
BR2_RISCV_ABI_ILP32=y

# Patches
BR2_GLOBAL_PATCH_DIR="$(BR2_EXTERNAL_LITEX_VEXRISCV_PATH)/patches"

# GCC
BR2_GCC_VERSION_11_X=y

# System
BR2_TARGET_GENERIC_GETTY=y
BR2_TARGET_GENERIC_GETTY_PORT="console"

# Filesystem
BR2_TARGET_ROOTFS_CPIO=y

# Kernel (litex-rebase branch)
BR2_LINUX_KERNEL=n
BR2_LINUX_KERNEL_CUSTOM_GIT=y
BR2_LINUX_KERNEL_CUSTOM_REPO_URL="https://github.com/Dolu1990/litex-linux.git"
BR2_LINUX_KERNEL_CUSTOM_REPO_VERSION="ae80e67c6b48bbedcd13db753237a25b3dec8301"
BR2_LINUX_KERNEL_USE_CUSTOM_CONFIG=y
BR2_LINUX_KERNEL_CUSTOM_CONFIG_FILE="$(BR2_EXTERNAL_LITEX_VEXRISCV_PATH)/board/litex_vexriscv_usbhost/linux.config"
BR2_LINUX_KERNEL_IMAGE=y

# Rootfs customisation
BR2_ROOTFS_OVERLAY="$(BR2_EXTERNAL_LITEX_VEXRISCV_PATH)/board/litex_vexriscv_usbhost/rootfs_overlay"
BR2_GLOBAL_PATCH_DIR="$(BR2_EXTERNAL_LITEX_VEXRISCV_PATH)/patches"

#BR2_PACKAGE_HOST_LINUX_HEADERS_CUSTOM_5_18=y

# Extra packages
#BR2_PACKAGE_DHRYSTONE_OPT=y
#BR2_PACKAGE_MICROPYTHON=y
#BR2_PACKAGE_SPIDEV_TEST=y
#BR2_PACKAGE_MTD=y
#BR2_PACKAGE_MTD_JFFS_UTILS=y

# Crypto
#BR2_PACKAGE_LIBATOMIC_OPS_ARCH_SUPPORTS=y
#BR2_PACKAGE_LIBATOMIC_OPS=y
#BR2_PACKAGE_OPENSSL=y
#BR2_PACKAGE_LIBRESSL=y
#BR2_PACKAGE_LIBRESSL_BIN=y
#BR2_PACKAGE_HAVEGED=y
#BR2_PACKAGE_VEXRISCV_AES=y # Uncomment to enable hardware AES

BR2_PACKAGE_BUSYBOX_CONFIG_FRAGMENT_FILES="$(BR2_EXTERNAL_LITEX_VEXRISCV_PATH)/configs/busybox.config"

# Kakao
BR2_PACKAGE_NCURSES=y
BR2_PACKAGE_NANO=y
BR2_PACKAGE_NANO_TINY=y
BR2_PACKAGE_LIBFFI=y
BR2_PACKAGE_TCC=y
BR2_PACKAGE_MICROPYTHON=y
BR2_PACKAGE_TINYSCHEME=y
BR2_PACKAGE_LINKS=y
BR2_PACKAGE_LRZSZ=y
BR2_PACKAGE_FBV=y
BR2_PACKAGE_FBV_PNG=y
BR2_PACKAGE_FBV_JPEG=y
BR2_PACKAGE_FBV_GIF=y
BR2_PACKAGE_SCREEN=y
BR2_PACKAGE_PICOCOM=y
BR2_PACKAGE_MINICOM=y
BR2_PACKAGE_DROPBEAR=y
BR2_PACKAGE_DROPBEAR_CLIENT=y
BR2_PACKAGE_DROPBEAR_SMALL=y
BR2_PACKAGE_MICROWINDOWS=y

# Kakao X11
BR2_TOOLCHAIN_BUILDROOT_CXX=y
BR2_PACKAGE_DIRECTFB=y
BR2_PACKAGE_SDL2_DIRECTFB=y
BR2_PACKAGE_SDL2_X11=y
BR2_PACKAGE_XORG7=y
BR2_PACKAGE_XSERVER_XORG_SERVER=y
BR2_PACKAGE_XAPP_SETXKBMAP=y
BR2_PACKAGE_XAPP_TWM=y
BR2_PACKAGE_XAPP_XCALC=y
BR2_PACKAGE_XAPP_XCLOCK=y
BR2_PACKAGE_XAPP_XDPYINFO=y
BR2_PACKAGE_XAPP_XEYES=y
BR2_PACKAGE_XAPP_XINIT=y
BR2_PACKAGE_XAPP_XINPUT=y
BR2_PACKAGE_XAPP_XMODMAP=y
BR2_PACKAGE_XAPP_XREFRESH=y
BR2_PACKAGE_XAPP_XWININFO=y
BR2_PACKAGE_XDRIVER_XF86_INPUT_KEYBOARD=y
BR2_PACKAGE_XDRIVER_XF86_INPUT_MOUSE=y
BR2_PACKAGE_XDRIVER_XF86_VIDEO_FBDEV=y
BR2_PACKAGE_XDOTOOL=y
BR2_PACKAGE_XTERM=y
BR2_PACKAGE_CHOCOLATE_DOOM=y
BR2_PACKAGE_DOOM_WAD=y

# eudev / x11 device drivers
BR2_ROOTFS_DEVICE_CREATION_STATIC=n
BR2_ROOTFS_DEVICE_CREATION_DYNAMIC_DEVTMPFS=n
BR2_ROOTFS_DEVICE_CREATION_DYNAMIC_MDEV=n
BR2_ROOTFS_DEVICE_CREATION_DYNAMIC_EUDEV=y
BR2_ROOTFS_DEVICE_TABLE="system/device_table.txt"
BR2_PACKAGE_EUDEV=y
BR2_PACKAGE_PROVIDES_UDEV="eudev"
BR2_PACKAGE_EUDEV_ENABLE_HWDB=y
BR2_PACKAGE_EUDEV_RULES_GEN=y
BR2_PACKAGE_EVTEST=y
BR2_PACKAGE_XDRIVER_XF86_INPUT_EVDEV=y
# BR2_PACKAGE_XDRIVER_XF86_INPUT_JOYSTICK is not set
BR2_PACKAGE_XDRIVER_XF86_INPUT_LIBINPUT=y
BR2_PACKAGE_XDRIVER_XF86_INPUT_MOUSE=y
```

## buildroot/package/llamac/Config.in
```kconfig
config BR2_PACKAGE_LLAMAC
    bool "llamac"
    help
      llamac

		https://github.com/karpathy/llama2.c
```

## buildroot/package/nanox/Config.in
```kconfig
config BR2_PACKAGE_NANOX
    bool "nanox"
    help
      Microwindows or Nano-X is a small graphical windowing system that implements both Win32 and Nano-X (X11-like) APIs for clipped graphics drawing in windows on Linux, Mac OS X, EMSCRIPTEN, Android and other platforms.

      http://www.microwindows.org/
```

## buildroot/package/netkit-telnet/Config.in
```kconfig
config BR2_PACKAGE_NETKIT_TELNET
    bool "netkit-telnet"
    help
      netkit-telnet

		https://github.com/machdyne/netkit-telnet

config BR2_PACKAGE_NETKIT_TELNET_REMOVE_LIBSTDCPP
   bool "netkit-telnet-remove-libstdc++"
   default n
   help
      Remove libstdc++ from target
```

## buildroot/package/tcc/Config.in
```kconfig
config BR2_PACKAGE_TCC
    bool "tcc"
    help
      The Tiny C Compiler is an x86, X86-64 and ARM processor C compiler
      initially written by Fabrice Bellard. 

      https://bellard.org/tcc/
```

## buildroot/package/tinyscheme/Config.in
```kconfig
config BR2_PACKAGE_TINYSCHEME
    bool "tinyscheme"
    help
      TinyScheme is a lightweight Scheme interpreter that implements
      as large a subset of R5RS as was possible without getting very
      large and complicated

      http://tinyscheme.sourceforge.net/
```

## buildroot/package/tlinks/Config.in
```kconfig
config BR2_PACKAGE_TLINKS
    bool "tlinks"
    help
      Tiny links web browser.
```

## buildroot/package/xfer/Config.in
```kconfig
config BR2_PACKAGE_XFER
    bool "xfer"
    help
      xfer file transfer utility
```

## buildroot/package/zssh/Config.in
```kconfig
config BR2_PACKAGE_ZSSH
    bool "zssh"
    help
      Zssh and Ztelnet

		https://zssh.sourceforge.net/
```
